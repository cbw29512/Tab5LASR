## onboard/main/Kconfig.projbuild
```kconfig
menu "Tab5 LASR experimental diagnostics"
    config LASR_CSI_DIAGNOSTIC
        bool "Read-only raw CSI laser candidate probe (UNVERIFIED)"
        default n
        help
            Off by default to preserve proven camera, color, and battery behavior.
            If explicitly enabled for an engineering build, captures the first
            frame as a reference and logs candidate flashes without creating
            shots, scores, or microSD writes. Requires physical SIRT and dark
            target calibration before any results may be trusted.
    config LASR_COMBINED_DIAGNOSTIC
        bool "Run isolated microSD smoke while raw CSI camera streams (review only)"
        default n
        depends on !LASR_SD_SMOKE_ON_BOOT
        help
            Never enabled in the normal camera image. Starts a separate
            no-format SD synthetic-session task after four physical CSI frames.
            Camera capture, preview, color and battery remain active. Laser
            candidate logs are UNSCORED and never persisted as live shots.
    config LASR_USB_PREVIEW_DIAGNOSTIC
        bool "USB JPEG preview engineering test (no Wi-Fi or SD probe)"
        default n
        depends on !LASR_COMBINED_DIAGNOSTIC && !LASR_SD_SMOKE_ON_BOOT
        help
            Dedicated recovery-guarded P4 USB Serial/JTAG camera preview.
            Uses JPEG hardware encoder on a bounded copy of display pixels,
            never retains V4L2 DMA frame memory. Streams real camera JPEG
            snapshots to a local browser via serial; no Wi-Fi, no scoring,
            no recording. Do not ship as production or modify the C6.

    config LASR_SD_SMOKE_ON_BOOT
        bool "One-time microSD write/readback test at boot (UNTESTED hardware)"
        default n
        help
            Explicit engineering opt-in only. After normal display and
            battery safety setup, mount SD without formatting, create one
            unique diagnostic file, verify contents, and unmount. Never run
            automatically on normal user firmware builds.
endmenu
```

## onboard/sdkconfig.defaults
```kconfig
CONFIG_IDF_TARGET="esp32p4"
CONFIG_ESPTOOLPY_FLASHSIZE_16MB=y
CONFIG_SPIRAM=y
CONFIG_SPIRAM_SPEED_200M=y
CONFIG_ESP32P4_SELECTS_REV_LESS_V3=y
CONFIG_ESP32P4_REV_MIN_100=y
CONFIG_ESP_CONSOLE_USB_SERIAL_JTAG=y
CONFIG_COMPILER_OPTIMIZATION_SIZE=y
CONFIG_FREERTOS_HZ=1000
CONFIG_IDF_EXPERIMENTAL_FEATURES=y
CONFIG_ESP_VIDEO_ENABLE_ISP_PIPELINE_CONTROLLER=y
CONFIG_CAMERA_SC202CS=y
CONFIG_CAM_CTRL_SPI_ENABLE=n
CONFIG_LV_CONF_SKIP=y
CONFIG_LV_FONT_MONTSERRAT_20=y
# Never wipe a user's SD card when mounting fails.
# CONFIG_BSP_SD_FORMAT_ON_MOUNT_FAIL is not set
CONFIG_LASR_SD_RECORDER=y
CONFIG_FATFS_LFN_HEAP=y
# USB COM downloader is only enabled for a separately accepted hardware image.
# CONFIG_LASR_USB_SERIAL_EXPORT is not set

# CI-tested LVGL reduced-widget configuration: retain CAMERA CANVAS,
# BUTTON, LABEL, IMAGE, THEME and all guarded battery UI primitives.
CONFIG_LV_BUILD_EXAMPLES=n
CONFIG_LV_BUILD_DEMOS=n
CONFIG_LV_USE_DRAW_SW=y
CONFIG_LV_USE_BUTTON=y
CONFIG_LV_USE_LABEL=y
CONFIG_LV_USE_CANVAS=y
CONFIG_LV_USE_IMAGE=y
CONFIG_LV_USE_THEME_DEFAULT=y
CONFIG_LV_COLOR_DEPTH_16=y
CONFIG_LV_USE_ANIMIMG=n
CONFIG_LV_USE_ARC=n
CONFIG_LV_USE_BAR=n
CONFIG_LV_USE_BUTTONMATRIX=n
CONFIG_LV_USE_CALENDAR=n
CONFIG_LV_USE_CHART=n
CONFIG_LV_USE_CHECKBOX=n
CONFIG_LV_USE_DROPDOWN=n
CONFIG_LV_USE_FLEX=n
CONFIG_LV_USE_GRID=n
CONFIG_LV_USE_GRIDNAV=n
CONFIG_LV_USE_IMAGEBUTTON=n
CONFIG_LV_USE_KEYBOARD=n
CONFIG_LV_USE_LED=n
CONFIG_LV_USE_LINE=n
CONFIG_LV_USE_LIST=n
CONFIG_LV_USE_MENU=n
CONFIG_LV_USE_MSGBOX=n
CONFIG_LV_USE_ROLLER=n
CONFIG_LV_USE_SCALE=n
CONFIG_LV_USE_SLIDER=n
CONFIG_LV_USE_SPAN=n
CONFIG_LV_USE_SPINBOX=n
CONFIG_LV_USE_SPINNER=n
CONFIG_LV_USE_SWITCH=n
CONFIG_LV_USE_TABLE=n
CONFIG_LV_USE_TABVIEW=n
CONFIG_LV_USE_TEXTAREA=n
CONFIG_LV_USE_TILEVIEW=n
CONFIG_LV_USE_WIN=n
CONFIG_LV_USE_THEME_SIMPLE=n
CONFIG_LV_USE_THEME_MONO=n
```
